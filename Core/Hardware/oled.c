#include "oled.h"
#include <stdio.h>
#include <stdarg.h>
#include <string.h>

/* SSD1306 命令 ---------------------------------------------------------------*/
#define OLED_CMD_SET_CONTRAST       0x81
#define OLED_CMD_DISPLAY_ON         0xAF
#define OLED_CMD_DISPLAY_OFF        0xAE
#define OLED_CMD_SET_MEM_MODE       0x20
#define OLED_CMD_SET_COL_ADDR       0x21
#define OLED_CMD_SET_PAGE_ADDR      0x22
#define OLED_CMD_SET_START_LINE     0x40
#define OLED_CMD_SEG_REMAP          0xA1
#define OLED_CMD_COM_SCAN_DEC       0xC8
#define OLED_CMD_COM_PINS           0xDA
#define OLED_CMD_SET_CHARGE_PUMP    0x8D
#define OLED_CMD_SET_PRECHARGE      0xD9
#define OLED_CMD_SET_VCOM_DETECT    0xDB
#define OLED_CMD_ENTIRE_DISP_ON     0xA4

/* 帧缓冲区（128 x 64 / 8 = 1024 字节）--------------------------------------*/
static uint8_t OLED_Buffer[OLED_WIDTH * OLED_HEIGHT / 8];

/* 6x8 字库（ASCII 32 ~ 127）-------------------------------------------------*/
static const uint8_t Font6x8[][6] = {
    {0x00,0x00,0x00,0x00,0x00,0x00}, /* ' ' */
    {0x00,0x00,0x5F,0x00,0x00,0x00}, /* '!' */
    {0x00,0x07,0x00,0x07,0x00,0x00}, /* '"' */
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    {0x44,0x64,0x54,0x4C,0x44,0x00}, /* 'z' */
};

/* I2C 写命令 ----------------------------------------------------------------*/
static void OLED_WriteCmd(uint8_t cmd)
{
    uint8_t buf[2] = {0x00, cmd};
    HAL_I2C_Master_Transmit(&OLED_I2C, OLED_ADDR, buf, 2, 10);
}

/* I2C 写数据 ----------------------------------------------------------------*/
static void OLED_WriteData(uint8_t data)
{
    uint8_t buf[2] = {0x40, data};
    HAL_I2C_Master_Transmit(&OLED_I2C, OLED_ADDR, buf, 2, 10);
}

/* 设置列地址范围 ------------------------------------------------------------*/
static void OLED_SetColAddr(uint8_t start, uint8_t end)
{
    OLED_WriteCmd(OLED_CMD_SET_COL_ADDR);
    OLED_WriteCmd(start);
    OLED_WriteCmd(end);
}

/* 设置页地址范围 ------------------------------------------------------------*/
static void OLED_SetPageAddr(uint8_t start, uint8_t end)
{
    OLED_WriteCmd(OLED_CMD_SET_PAGE_ADDR);
    OLED_WriteCmd(start);
    OLED_WriteCmd(end);
}

/**
  * @brief  初始化 SSD1306 OLED（I2C2）
  * @retval 无
  */
void OLED_Init(void)
{
    HAL_Delay(100);

    OLED_WriteCmd(OLED_CMD_DISPLAY_OFF);

    OLED_WriteCmd(OLED_CMD_SET_MEM_MODE);
    OLED_WriteCmd(0x00);                    /* 水平寻址模式 */

    OLED_WriteCmd(OLED_CMD_SET_START_LINE | 0x00);

    OLED_WriteCmd(OLED_CMD_SEG_REMAP);          /* 列地址 127 映射到 SEG0 */
    OLED_WriteCmd(OLED_CMD_COM_SCAN_DEC);       /* 从 COM63 扫描到 COM0 */

    OLED_WriteCmd(OLED_CMD_COM_PINS);
    OLED_WriteCmd(0x12);                    /* 128x64, 替代 COM 布局 */

    OLED_WriteCmd(OLED_CMD_SET_CONTRAST);
    OLED_WriteCmd(0x7F);

    OLED_WriteCmd(OLED_CMD_ENTIRE_DISP_ON);

    OLED_WriteCmd(OLED_CMD_SET_PRECHARGE);
    OLED_WriteCmd(0xF1);

    OLED_WriteCmd(OLED_CMD_SET_VCOM_DETECT);
    OLED_WriteCmd(0x40);

    OLED_WriteCmd(OLED_CMD_SET_CHARGE_PUMP);
    OLED_WriteCmd(0x14);                    /* 使能电荷泵 */

    OLED_WriteCmd(OLED_CMD_DISPLAY_ON);

    OLED_Clear();
    OLED_Refresh();
}

/**
  * @brief  清空帧缓冲区
  * @retval 无
  */
void OLED_Clear(void)
{
    memset(OLED_Buffer, 0x00, sizeof(OLED_Buffer));
}

/**
  * @brief  全屏刷新：将帧缓冲区写入 OLED
  * @retval 无
  */
void OLED_Refresh(void)
{
    OLED_SetColAddr(0, OLED_WIDTH - 1);
    OLED_SetPageAddr(0, (OLED_HEIGHT / 8) - 1);

    for (uint16_t i = 0; i < sizeof(OLED_Buffer); i++)
    {
        OLED_WriteData(OLED_Buffer[i]);
    }
}

/**
  * @brief  在缓冲区中画一个点
  * @param  x: 列（0~127）
  * @param  y: 行（0~63）
  * @param  color: 1=点亮, 0=熄灭
  * @retval 无
  */
static void OLED_DrawPixel(uint8_t x, uint8_t y, uint8_t color)
{
    if (x >= OLED_WIDTH || y >= OLED_HEIGHT) return;

    if (color)
        OLED_Buffer[x + (y / 8) * OLED_WIDTH] |=  (1 << (y % 8));
    else
        OLED_Buffer[x + (y / 8) * OLED_WIDTH] &= ~(1 << (y % 8));
}

/**
  * @brief  显示 6x8 或 8x16 字符串
  * @param  x, y: 起始坐标
  * @param  str: 字符串
  * @param  size: 12 = 6x8, 16 = 8x16
  * @retval 无
  */
void OLED_ShowString(uint8_t x, uint8_t y, const char *str, uint8_t size)
{
    while (*str)
    {
        if (x + size / 2 > OLED_WIDTH) { x = 0; y += size / 8 * 8; }
        if (y >= OLED_HEIGHT) break;

        if (size == 12)
        {
            /* 6x8 字体 */
            uint8_t c = *str;
            if (c >= ' ' && c <= 'z')
            {
                for (uint8_t i = 0; i < 6; i++)
                {
                    uint8_t line = Font6x8[c - ' '][i];
                    for (uint8_t j = 0; j < 8; j++)
                    {
                        OLED_DrawPixel(x + i, y + j, (line >> j) & 0x01);
                    }
                }
            }
            x += 6;
        }
        else if (size == 16)
        {
            /* 8x16：上半部分 + 下半部分 */
            uint8_t c = *str;
            if (c >= ' ' && c <= 'z')
            {
                for (uint8_t i = 0; i < 6; i++)
                {
                    uint8_t line = Font6x8[c - ' '][i];
                    for (uint8_t j = 0; j < 7; j++)
                    {
                        OLED_DrawPixel(x + i,     y + j,     (line >> j) & 0x01);
                        OLED_DrawPixel(x + i + 1, y + j,     (line >> j) & 0x01);
                        OLED_DrawPixel(x + i,     y + j + 8, (line >> j) & 0x01);
                        OLED_DrawPixel(x + i + 1, y + j + 8, (line >> j) & 0x01);
                    }
                }
            }
            x += 12;
        }

        str++;
    }
}

/**
  * @brief  显示整数
  * @param  x, y: 起始坐标
  * @param  num: 整数
  * @param  len: 位数
  * @param  size: 12 或 16
  * @retval 无
  */
void OLED_ShowNum(uint8_t x, uint8_t y, int32_t num, uint8_t len, uint8_t size)
{
    char buf[12];
    char fmt[8];
    snprintf(fmt, sizeof(fmt), "%%%dd", len);
    snprintf(buf, sizeof(buf), fmt, (int)num);
    OLED_ShowString(x, y, buf, size);
}

/**
  * @brief  显示浮点数
  * @param  x, y: 起始坐标
  * @param  num: 浮点数
  * @param  int_len: 整数位数
  * @param  dec_len: 小数位数
  * @param  size: 12 或 16
  * @retval 无
  */
void OLED_ShowFloat(uint8_t x, uint8_t y, float num,
                    uint8_t int_len, uint8_t dec_len, uint8_t size)
{
    char buf[16];
    snprintf(buf, sizeof(buf), "%*.*f", int_len + dec_len + 1, dec_len, num);
    OLED_ShowString(x, y, buf, size);
}

/**
  * @brief  设置文本光标（简化版：定位到字符行列）
  * @param  x: 列像素（0~127）
  * @param  y: 行像素（0~63）
  * @retval 无
  */
void OLED_SetCursor(uint8_t x, uint8_t y)
{
    /* 设置写入窗口 */
    OLED_SetColAddr(x, OLED_WIDTH - 1);
    OLED_SetPageAddr(y / 8, (OLED_HEIGHT / 8) - 1);
}

/**
  * @brief  OLED 格式化输出（简易版）
  * @param  fmt: printf 风格格式串
  * @retval 无
  * @note   输出到帧缓冲区，需调 OLED_Refresh() 才能显示，
  *         文字始终从 (0,0) 开始
  */
void OLED_Printf(const char *fmt, ...)
{
    char buf[64];
    va_list args;
    va_start(args, fmt);
    vsnprintf(buf, sizeof(buf), fmt, args);
    va_end(args);

    OLED_ShowString(0, 0, buf, 12);
}